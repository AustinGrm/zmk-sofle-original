## config/west.yml
```yaml
manifest:
  remotes:
    - name: zmkfirmware
      url-base: https://github.com/zmkfirmware
  projects:
    - name: eyelash_sofle
      url: https://github.com/a741725193/zmk-sofle
      revision: 504d2a54c861a85a279de6d3a7acf59c335820d4
    - name: zmk
      remote: zmkfirmware
      revision: v0.3
      import: app/west.yml
  self:
    path: config
```
